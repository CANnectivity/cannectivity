## Kconfig
```kconfig
# SPDX-FileCopyrightText: Copyright (c) 2024-2026 Henrik Brix Andersen <henrik@brixandersen.dk>
#
# SPDX-License-Identifier: Apache-2.0

rsource "subsys/Kconfig"
```

## app/boards/canbardo_same70n20b.conf
```kconfig
# Copyright (c) 2026 Henrik Brix Andersen <henrik@brixandersen.dk>
# SPDX-License-Identifier: Apache-2.0

CONFIG_CANNECTIVITY_USB_SELF_POWERED=n
CONFIG_USBD_GS_USB_COMPATIBILITY_MODE=n
```

## app/boards/candlelight_stm32f072xb.conf
```kconfig
# Copyright (c) 2024-2025 Henrik Brix Andersen <henrik@brixandersen.dk>
# SPDX-License-Identifier: Apache-2.0

CONFIG_CANNECTIVITY_USB_SELF_POWERED=n
CONFIG_CAN_FD_MODE=n
```

## app/boards/candlelightfd_stm32g0b1xx_dual.conf
```kconfig
# SPDX-FileCopyrightText: Copyright (c) 2024-2026 Henrik Brix Andersen <henrik@brixandersen.dk>
#
# SPDX-License-Identifier: Apache-2.0

CONFIG_CANNECTIVITY_USB_SELF_POWERED=n
```

## app/boards/candlelightfd_stm32g0b1xx_dual_usbd_next.conf
```kconfig
# Copyright (c) 2025 Henrik Brix Andersen <henrik@brixandersen.dk>
# SPDX-License-Identifier: Apache-2.0

CONFIG_CANNECTIVITY_USB_SELF_POWERED=n
CONFIG_USBD_GS_USB_MAX_CHANNELS=2
```

## app/boards/frdm_mcxn947_mcxn947_cpu0.conf
```kconfig
# Copyright (c) 2025-2026 Henrik Brix Andersen <henrik@brixandersen.dk>
# SPDX-License-Identifier: Apache-2.0

CONFIG_CAN_MCUX_FLEXCAN_MAX_FILTERS=2
```

## app/boards/mks_canable_v20_stm32g431xx.conf
```kconfig
# SPDX-FileCopyrightText: Copyright (c) 2025-2026 Henrik Brix Andersen <henrik@brixandersen.dk>
# SPDX-FileCopyrightText: Copyright (c) 2024 Alexander Kozhinov <ak.alexander.kozhinov@gmail.com>
#
# SPDX-License-Identifier: Apache-2.0

CONFIG_CANNECTIVITY_USB_SELF_POWERED=n

# The two lines below are needed to reduce flash usage
CONFIG_LTO=y
CONFIG_ISR_TABLES_LOCAL_DECLARATION=y
```

## app/boards/native_sim.conf
```kconfig
# Copyright (c) 2024 Henrik Brix Andersen <henrik@brixandersen.dk>
# SPDX-License-Identifier: Apache-2.0

CONFIG_USB_DEVICE_GS_USB_MAX_CHANNELS=3
CONFIG_COUNTER_NATIVE_POSIX_FREQUENCY=1000000
```

## app/boards/native_sim_native_64.conf
```kconfig
# Copyright (c) 2024-2025 Henrik Brix Andersen <henrik@brixandersen.dk>
# SPDX-License-Identifier: Apache-2.0

CONFIG_COUNTER_NATIVE_SIM_FREQUENCY=1000000
```

## app/boards/rh02_plus_2026_stm32g431xx.conf
```kconfig
# SPDX-FileCopyrightText: Copyright (c) 2026 nullstalgia
#
# SPDX-License-Identifier: Apache-2.0

CONFIG_CANNECTIVITY_USB_SELF_POWERED=n

# The two lines below are needed to reduce flash usage
CONFIG_LTO=y
CONFIG_ISR_TABLES_LOCAL_DECLARATION=y
```

## app/boards/weact_stm32f446_core_stm32f446xx.conf
```kconfig
# Copyright (c) 2026 Chris Chatelain <chris@digiex.ca>
# SPDX-License-Identifier: Apache-2.0

CONFIG_CANNECTIVITY_USB_SELF_POWERED=n
CONFIG_CAN_FD_MODE=n
CONFIG_CAN_STM32_BXCAN_MAX_STD_ID_FILTERS=1
CONFIG_CAN_STM32_BXCAN_MAX_EXT_ID_FILTERS=1
```

## app/sysbuild/mcuboot/boards/canbardo_same70n20b.conf
```kconfig
# Copyright (c) 2024-2025 Henrik Brix Andersen <henrik@brixandersen.dk>
# SPDX-License-Identifier: Apache-2.0

CONFIG_BOOT_USB_DFU_GPIO=y
CONFIG_MCUBOOT_INDICATION_LED=y
```

## app/sysbuild/mcuboot/boards/frdm_k64f_mk64f12.conf
```kconfig
# Copyright (c) 2024 Henrik Brix Andersen <henrik@brixandersen.dk>
# SPDX-License-Identifier: Apache-2.0

# This is using the deprecated USB device stack
CONFIG_DEPRECATION_TEST=y

CONFIG_BOOT_USB_DFU_GPIO=y
```

## app/sysbuild/mcuboot/boards/frdm_k64f_mk64f12_legacy.conf
```kconfig
# Copyright (c) 2024 Henrik Brix Andersen <henrik@brixandersen.dk>
# SPDX-License-Identifier: Apache-2.0

# This is using the deprecated USB device stack
CONFIG_DEPRECATION_TEST=y

CONFIG_BOOT_USB_DFU_GPIO=y
CONFIG_USB_DEVICE_MANUFACTURER="CANnectivity"
CONFIG_USB_DEVICE_PRODUCT="CANnectivity USB to CAN adapter (MCUboot DFU)"
CONFIG_USB_DEVICE_VID=0x1209
CONFIG_USB_DEVICE_PID=0xca02
CONFIG_USB_DEVICE_DFU_PID=0xca02
```

## app/sysbuild/mcuboot/boards/frdm_k64f_mk64f12_usbd_next.conf
```kconfig
# Copyright (c) 2025 Henrik Brix Andersen <henrik@brixandersen.dk>
# SPDX-License-Identifier: Apache-2.0

# Override default y for this board
CONFIG_BOOT_USB_DFU_GPIO=n
```

## boards/jbr-engineering/entree/Kconfig.entree
```kconfig
# Copyright (c) 2026 John Whittington <git@jbrengineering.co.uk>
# SPDX-License-Identifier: Apache-2.0

config BOARD_ENTREE
	select SOC_STM32G0B1XX
```

## boards/jbr-engineering/entree/board.yml
```yaml
board:
  name: entree
  full_name: JBR Engineering Entree V2
  vendor: jbr-engineering
  socs:
    - name: stm32g0b1xx
```

## dts/bindings/usb/gs_usb.yaml
```yaml
# Copyright (c) 2022-2025 Henrik Brix Andersen <henrik@brixandersen.dk>
# SPDX-License-Identifier: Apache-2.0

description: Geschwister Schneider USB/CAN

compatible: "gs_usb"

include: base.yaml

properties:
  label:
    description: |
      Optional string for use as the USB interface string descriptor.
```

## subsys/usb/device/Kconfig
```kconfig
# Copyright (c) 2024 Henrik Brix Andersen <henrik@brixandersen.dk>
# SPDX-License-Identifier: Apache-2.0

if USB_DEVICE_STACK

rsource "class/Kconfig"

endif # USB_DEVICE_STACK
```

## subsys/usb/device/class/Kconfig.gs_usb
```kconfig
# Copyright (c) 2022-2024 Henrik Brix Andersen <henrik@brixandersen.dk>
# SPDX-License-Identifier: Apache-2.0

config USB_DEVICE_GS_USB
	bool "Geschwister Schneider USB/CAN Device Class support"
	default y
	depends on DT_HAS_GS_USB_ENABLED
	select NET_BUF
	select CAN
	imply CAN_ACCEPT_RTR
	help
	  Geschwister Schneider USB/CAN (gs_usb) device class support.

if USB_DEVICE_GS_USB

module = USB_DEVICE_GS_USB
module-str = gs_usb
source "subsys/logging/Kconfig.template.log_config"

config USB_DEVICE_GS_USB_MAX_CHANNELS
	int "Maximum number of supported channels"
	default 1
	range 1 256
	help
	  Maximum number of supported Geschwister Schneider USB/CAN (gs_usb) channels. Each channel
	  represents one CAN controller.

	  The Linux kernel driver supports up to 3 channels. Other drivers may support just one
	  channel.

config USB_DEVICE_GS_USB_POOL_SIZE
	int "Host frame buffer pool size"
	default 20
	help
	  Size of the pool used for allocating Geschwister Schneider USB/CAN (gs_usb) host
	  frames. The pool is used for both RX and TX, and shared between all channels of a given
	  gs_usb instance.

config USB_DEVICE_GS_USB_IDENTIFICATION
	bool "Enable support for CAN channel identification"
	help
	  Enable support for CAN channel identification callback provided by the application.

config USB_DEVICE_GS_USB_TIMESTAMP
	bool "Enable support for hardware timestamps"
	help
	  Enable support for hardware timestamps provided by the application.

config USB_DEVICE_GS_USB_TIMESTAMP_SOF
	bool "Capture hardware timestamp on USB SoF"
	depends on USB_DEVICE_GS_USB_TIMESTAMP
	select USB_DEVICE_SOF
	help
	  Capture the hardware timestamp on each USB Start of Frame event. This improves the
	  timestamp accurracy with the cost of a higher CPU load.

config USB_DEVICE_GS_USB_TERMINATION
	bool "Enable support for CAN bus termination resistors"
	help
	  Enable support for software-controlled CAN termination resistors.

config USB_DEVICE_GS_USB_RX_THREAD_STACK_SIZE
	int "Stack size for the RX thread"
	default 1024
	help
	  Size of the stack used for the internal RX thread.

config USB_DEVICE_GS_USB_RX_THREAD_PRIO
	int "Priority for the RX thread"
	default 0
	help
	  Priority level for the internal RX thread.

config USB_DEVICE_GS_USB_TX_THREAD_STACK_SIZE
	int "Stack size for the TX thread"
	default 1024
	help
	  Size of the stack used for the internal TX thread.

config USB_DEVICE_GS_USB_TX_THREAD_PRIO
	int "Priority for the TX thread"
	default 0
	help
	  Priority level for the internal TX thread.

config USB_DEVICE_GS_USB_MAX_PACKET_SIZE
	int "Maximum bulk endpoint packet size"
	default 512 if USB_DC_HAS_HS_SUPPORT
	default 64
	range 64 512
	help
	  Maximum bulk endpoint packet size in bytes. Classic CAN host frames fit into 64 byte
	  packets, whereas CAN FD host frames can benefit from a maximum packet size of 512 bytes.

config USB_DEVICE_GS_USB_COMPATIBILITY_MODE
	bool "Enable compatibility mode"
	default y
	help
	  Enable Geschwister Schneider USB/CAN (gs_usb) driver compatibility mode.

	  The Linux kernel gs_usb driver prior to kernel v6.12.5 uses hardcoded USB endpoint
	  addresses 0x81 (bulk IN) and 0x02 (bulk OUT). The same assumption on USB endpoint
	  addresses may be present in other drivers as well (e.g. python-can).

	  Depending on the capabilities of the USB device controller, the requested USB endpoint
	  addresses may be rewritten by the Zephyr USB device stack at runtime. Enabling
	  compatibility mode will include a second bulk OUT endpoint to ensure correct operation
	  with gs_usb drivers using the hardcoded USB endpoint addresses described above.

	  It is safe to enable compatibility mode regardless of the driver being used, but the
	  resulting firmware will require slightly more RAM and flash resources.

endif # USB_DEVICE_GS_USB
```

## subsys/usb/device_next/Kconfig
```kconfig
# SPDX-FileCopyrightText: Copyright (c) 2024-2026 Henrik Brix Andersen <henrik@brixandersen.dk>
#
# SPDX-License-Identifier: Apache-2.0

if USB_DEVICE_STACK_NEXT

rsource "class/Kconfig"

endif # USB_DEVICE_STACK_NEXT
```

## subsys/usb/device_next/class/Kconfig
```kconfig
# SPDX-FileCopyrightText: Copyright (c) 2024-2026 Henrik Brix Andersen <henrik@brixandersen.dk>
#
# SPDX-License-Identifier: Apache-2.0

rsource "Kconfig.gs_usb"
```

## subsys/usb/device_next/class/Kconfig.gs_usb
```kconfig
# Copyright (c) 2022-2024 Henrik Brix Andersen <henrik@brixandersen.dk>
# SPDX-License-Identifier: Apache-2.0

config USBD_GS_USB
	bool "Geschwister Schneider USB/CAN Device Class support [EXPERIMENTAL]"
	default y
	depends on DT_HAS_GS_USB_ENABLED
	select EXPERIMENTAL
	select NET_BUF
	select CAN
	imply CAN_ACCEPT_RTR
	help
	  Geschwister Schneider USB/CAN (gs_usb) device class support.

if USBD_GS_USB

module = USBD_GS_USB
module-str = gs_usb
source "subsys/logging/Kconfig.template.log_config"

config USBD_GS_USB_MAX_CHANNELS
	int "Maximum number of supported channels"
	default 1
	range 1 256
	help
	  Maximum number of supported Geschwister Schneider USB/CAN (gs_usb) channels. Each channel
	  represents one CAN controller.

	  The Linux kernel driver supports up to 3 channels. Other drivers may support just one
	  channel.

config USBD_GS_USB_POOL_SIZE
	int "Host frame buffer pool size"
	default 20
	help
	  Size of the pool used for allocating Geschwister Schneider USB/CAN (gs_usb) host
	  frames. The pool is used for both RX and TX, and shared between all channels of a given
	  gs_usb instance.

config USBD_GS_USB_IDENTIFICATION
	bool "Enable support for CAN channel identification"
	help
	  Enable support for CAN channel identification callback provided by the application.

config USBD_GS_USB_TIMESTAMP
	bool "Enable support for hardware timestamps"
	help
	  Enable support for hardware timestamps provided by the application.

config USBD_GS_USB_TIMESTAMP_SOF
	bool "Capture hardware timestamp on USB SoF"
	depends on USBD_GS_USB_TIMESTAMP
	help
	  Capture the hardware timestamp on each USB Start of Frame event. This improves the
	  timestamp accurracy with the cost of a higher CPU load.

config USBD_GS_USB_TERMINATION
	bool "Enable support for CAN bus termination resistors"
	help
	  Enable support for software-controlled CAN termination resistors.

config USBD_GS_USB_RX_THREAD_STACK_SIZE
	int "Stack size for the RX thread"
	default 1024
	help
	  Size of the stack used for the internal RX thread.

config USBD_GS_USB_RX_THREAD_PRIO
	int "Priority for the RX thread"
	default 0
	help
	  Priority level for the internal RX thread.

config USBD_GS_USB_TX_THREAD_STACK_SIZE
	int "Stack size for the TX thread"
	default 1024
	help
	  Size of the stack used for the internal TX thread.

config USBD_GS_USB_TX_THREAD_PRIO
	int "Priority for the TX thread"
	default 0
	help
	  Priority level for the internal TX thread.

endif # USBD_GS_USB
```

## tests/subsys/usb/gs_usb/cxx/testcase.yaml
```yaml
# Copyright (c) 2024-2026 Henrik Brix Andersen <henrik@brixandersen.dk>
# SPDX-License-Identifier: Apache-2.0

common:
  tags:
    - usb
    - can
  build_only: true
  platform_allow:
    - native_sim
    - native_sim/native/64
tests:
  usb.gs_usb.cxx98:
    extra_configs:
      - CONFIG_STD_CPP98=y
  usb.gs_usb.cxx11:
    extra_configs:
      - CONFIG_STD_CPP11=y
  usb.gs_usb.cxx14:
    extra_configs:
      - CONFIG_STD_CPP14=y
  usb.gs_usb.cxx17:
    extra_configs:
      - CONFIG_STD_CPP17=y
  usb.gs_usb.cxx20:
    extra_configs:
      - CONFIG_STD_CPP20=y
  usb.gs_usb.cxx23:
    extra_configs:
      - CONFIG_STD_CPP23=y
```

## tests/subsys/usb/gs_usb/host/testcase.yaml
```yaml
# Copyright (c) 2024 Henrik Brix Andersen <henrik@brixandersen.dk>
# SPDX-License-Identifier: Apache-2.0

common:
  tags:
    - usb
    - can
  harness: pytest
  harness_config:
    pytest_dut_scope: session
    fixture: usb
tests:
  usb.gs_usb.host:
    depends_on:
      - usb_device
      - can
    integration_platforms:
      - frdm_k64f/mk64f12
  usb.gs_usb.host.usbd_next:
    depends_on:
      - usbd
      - can
    integration_platforms:
      - frdm_k64f/mk64f12
    extra_args:
      - FILE_SUFFIX=usbd_next
```
