## app/boards/dsdtech_shc31a_stm32g431xx.conf
```kconfig
# SPDX-FileCopyrightText: Copyright (c) 2026 Base Power Company
#
# SPDX-License-Identifier: Apache-2.0

CONFIG_CANNECTIVITY_USB_SELF_POWERED=n
```
