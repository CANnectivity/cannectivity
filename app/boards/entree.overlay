#include <zephyr/dt-bindings/gpio/gpio.h>
#include "../app.overlay"

/ {
	cannectivity: cannectivity {
		compatible = "cannectivity";
		timestamp-counter = <&counter2>;

		channel0 {
			compatible = "cannectivity-channel";
			termination-gpios = <&gpiob 4 GPIO_ACTIVE_HIGH>;
			can-controller = <&fdcan1>;
			state-led = <&standby_led>;
			error-led = <&error_led>;
			activity-leds = <&led_rx &led_tx>;
		};

		/* channel1 { */
		/* 	compatible = "cannectivity-channel"; */
		/* 	can-controller = <&fdcan2>; */
		/* 	state-led = <&led_tx>; */
		/* }; */
	};
};
