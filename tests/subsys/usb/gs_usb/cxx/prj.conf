## CMakeLists.txt
```
# SPDX-FileCopyrightText: Copyright (c) 2024-2026 Henrik Brix Andersen <henrik@brixandersen.dk>
#
# SPDX-License-Identifier: Apache-2.0

cmake_minimum_required(VERSION 3.28.0)
find_package(Zephyr REQUIRED HINTS $ENV{ZEPHYR_BASE})

project(cxx LANGUAGES CXX)

FILE(GLOB app_sources src/*.cpp)
target_sources(app PRIVATE ${app_sources})
```

## prj.conf
```kconfig
# SPDX-FileCopyrightText: Copyright (c) 2024-2026 Henrik Brix Andersen <henrik@brixandersen.dk>
#
# SPDX-License-Identifier: Apache-2.0

CONFIG_CPP=y

CONFIG_USB_DEVICE_STACK_NEXT=y

CONFIG_USBD_GS_USB_IDENTIFICATION=y
CONFIG_USBD_GS_USB_TIMESTAMP=y
CONFIG_USBD_GS_USB_TERMINATION=y
```

## app.overlay
```dts
/*
 * SPDX-FileCopyrightText: Copyright (c) 2024-2026 Henrik Brix Andersen <henrik@brixandersen.dk>
 *
 * SPDX-License-Identifier: Apache-2.0
 */

/ {
	gs_usb0: gs_usb0 {
		compatible = "gs_usb";
	};
};
```

## src/main.cpp
```c
/*
 * SPDX-FileCopyrightText: Copyright (c) 2024-2026 Henrik Brix Andersen <henrik@brixandersen.dk>
 *
 * SPDX-License-Identifier: Apache-2.0
 */

#include <cannectivity/usb/class/gs_usb.h>
```
