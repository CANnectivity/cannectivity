## west.yml
```yaml
# Copyright (c) 2024-2025 Henrik Brix Andersen <henrik@brixandersen.dk>
# SPDX-License-Identifier: Apache-2.0

manifest:
  remotes:
    - name: zephyrproject-rtos
      url-base: https://github.com/zephyrproject-rtos
  projects:
    - name: zephyr
      remote: zephyrproject-rtos
      revision: v4.3-branch
      clone-depth: 1
      import:
        name-allowlist:
          - cmsis_6
          - hal_atmel
          - hal_nxp
          - hal_stm32
          - mcuboot
          - net-tools
          - segger
```
